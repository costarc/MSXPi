; MSXPi Interface
; Version 1.7.0
; ------------------------------------------------------------------------------
; MIT License
;
; Copyright (c) 2015-2026 Ronivon Costa
;
; Permission is hereby granted, free of charge, to any person obtaining a copy
; of this software and associated documentation files (the "Software"), to deal
; in the Software without restriction, including without limitation the rights
; to use, copy, modify, merge, publish, distribute, sublicense, and/or sell
; copies of the Software, and to permit persons to whom the Software is
; furnished to do so, subject to the following conditions:
;
; The above copyright notice and this permission notice shall be included in all
; copies or substantial portions of the Software.
;
; THE SOFTWARE IS PROVIDED "AS IS", WITHOUT WARRANTY OF ANY KIND, EXPRESS OR
; IMPLIED, INCLUDING BUT NOT LIMITED TO THE WARRANTIES OF MERCHANTABILITY,
; FITNESS FOR A PARTICULAR PURPOSE AND NONINFRINGEMENT. IN NO EVENT SHALL THE
; AUTHORS OR COPYRIGHT HOLDERS BE LIABLE FOR ANY CLAIM, DAMAGES OR OTHER
; LIABILITY, WHETHER IN AN ACTION OF CONTRACT, TORT OR OTHERWISE, ARISING FROM,
; OUT OF OR IN CONNECTION WITH THE SOFTWARE OR THE USE OR OTHER DEALINGS IN THE
; SOFTWARE.
; ------------------------------------------------------------------------------
; Generated by asm-common/transport/generate.py; edit payload.z80.
 ifndef MSXPI_LINK2
; Canonical Z80 payload kernel. Generated for zmac and SDCC by generate.py.
; DE=buffer, BC=count, HL=16-bit running sum. Preserves IX/IY and shadows.
; CF error: A=RC_ESCPRESSED, DE/BC/HL describe completed bytes only.
; Polled mode: caller owns link and leaves /WAIT off (UNAPI ETH_END does so).
PAYLOAD_RX:
    ld a,b
    or c
    ret z
PAYLOAD_RX_LOOP:
    ld a,c
    or a
    call z,PAYLOAD_ESCAPE
    ret c
    call PAYLOAD_WAIT
    ret c
    xor a
    out (0x56),a
    call PAYLOAD_WAIT
    ret c
    in a,(0x5a)
 ifdef MSXPI_DRIVER
    call STORE_BYTE
 else
    ld (de),a
 endif
    call PAYLOAD_ADVANCE
    jr nz,PAYLOAD_RX_LOOP
    ret
 endif
 ifdef MSXPI_PAYLOAD_ROM_SPLIT
 else
 ifndef MSXPI_LINK2
PAYLOAD_TX:
    ld a,b
    or c
    ret z
PAYLOAD_TX_LOOP:
    ld a,c
    or a
    call z,PAYLOAD_ESCAPE
    ret c
    call PAYLOAD_WAIT
    ret c
    ld a,(de)
    out (0x5a),a
    call PAYLOAD_ADVANCE
    jr nz,PAYLOAD_TX_LOOP
    ret
 endif
 ifndef MSXPI_LINK2
; A is the completed byte. NZ=count remains, CF=0 on completion.
PAYLOAD_ADVANCE:
    add a,l
    ld l,a
    jr nc,PAYLOAD_NO_CARRY
    inc h
PAYLOAD_NO_CARRY:
    inc de
    dec bc
    ld a,b
    or c
    ret
 endif
; Fast ready path changes AF only. Bounded slow path preserves registers.
; 18 * 65535 polls gives about 15-17 seconds at 3.58 MHz, including
; MSX I/O/opcode waits. Allow cold player startup before native fallback.
; This is a per-transfer CPU-time limit (shorter on accelerated CPUs).
; Goonies profile only (not generated): a disconnected Pi must not freeze the game.
; CF on a timeout, A = RC_CONNERR (LINK2 hands A to its caller).
GOONIES_WAIT_PASSES equ 18
PAYLOAD_WAIT:
    in a,(0x56)
    or a
    ret z
    push bc
    push de
    ld d,GOONIES_WAIT_PASSES
goonies_wait_pass:
    ld bc,0xffff
goonies_wait_loop:
    in a,(0x56)
    or a
    jr z,goonies_wait_done
    dec bc
    ld a,b
    or c
    jr nz,goonies_wait_loop
    dec d
    jr nz,goonies_wait_pass
    ld a,0xe8
    scf
goonies_wait_done:
    pop de
    pop bc
    ret
; Tail of PAYLOAD_ESCAPE, placed before it so the DOS ROM keeps it in the wait
; hole: the ESC hole is too small for the two-row check. C bit 2 = 0 when
; CTRL+ESC is down, B = port AA to restore, incoming IFF state on the stack.
PAYLOAD_ESCAPE_DONE:
    ld a,b
    out (0xaa),a
    pop af
    jp po,PAYLOAD_ESCAPE_IFF_OFF
    ei
PAYLOAD_ESCAPE_IFF_OFF:
    ld a,c
    pop bc
    and 4
    ret nz
    ld a,0xe2
    scf
    ret
; Abort key is CTRL+ESC: ESC alone stays an ordinary key for programs.
; ESC = row 7 bit 2, CTRL = row 6 bit 1, both active low.
; Preserve row selection, upper PPI bits and the incoming interrupt state.
; No BIOS call: safe with interrupts disabled, no reliance on BSS.
PAYLOAD_ESCAPE:
    push bc
    ld a,i
    push af
    di
    in a,(0xaa)
    ld b,a
    and 0xf0
    or 7
    out (0xaa),a
    in a,(0xa9)
    ld c,a
    ld a,b
    and 0xf0
    or 6
    out (0xaa),a
    in a,(0xa9)
    ; Move CTRL to bit 2: bit 2 stays 0 only if both keys are down.
    rlca
    or c
    ld c,a
    jp PAYLOAD_ESCAPE_DONE
 endif
