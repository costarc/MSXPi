; MSXPi Interface
; Version 1.6.1
; ------------------------------------------------------------------------------
; MIT License
;
; Copyright (c) 2015-2026 Ronivon Costa
;
; Permission is hereby granted, free of charge, to any person obtaining a copy
; of this software and associated documentation files (the "Software"), to deal
; in the Software without restriction, including without limitation the rights
; to use, copy, modify, merge, publish, distribute, sublicense, and/or sell
; copies of the Software, and to permit persons to whom the Software is
; furnished to do so, subject to the following conditions:
;
; The above copyright notice and this permission notice shall be included in all
; copies or substantial portions of the Software.
;
; THE SOFTWARE IS PROVIDED "AS IS", WITHOUT WARRANTY OF ANY KIND, EXPRESS OR
; IMPLIED, INCLUDING BUT NOT LIMITED TO THE WARRANTIES OF MERCHANTABILITY,
; FITNESS FOR A PARTICULAR PURPOSE AND NONINFRINGEMENT. IN NO EVENT SHALL THE
; AUTHORS OR COPYRIGHT HOLDERS BE LIABLE FOR ANY CLAIM, DAMAGES OR OTHER
; LIABILITY, WHETHER IN AN ACTION OF CONTRACT, TORT OR OTHERWISE, ARISING FROM,
; OUT OF OR IN CONNECTION WITH THE SOFTWARE OR THE USE OR OTHER DEALINGS IN THE
; SOFTWARE.
; ------------------------------------------------------------------------------
; Generated by asm-common/transport/generate.py; edit payload.z80.
; A is the completed byte. NZ=count remains, CF=0 on completion.
PAYLOAD_ADVANCE:
    add a,l
    ld l,a
    jr nc,PAYLOAD_NO_CARRY
    inc h
PAYLOAD_NO_CARRY:
    inc de
    dec bc
    ld a,b
    or c
    ret
; Fast ready path changes AF only. Slow path checks ESC every 256 polls.
PAYLOAD_WAIT:
    in a,(0x56)
    or a
    ret z
    push bc
    ld b,0
PAYLOAD_WAIT_SLOW:
    in a,(0x56)
    or a
    jr z,PAYLOAD_WAIT_DONE
    djnz PAYLOAD_WAIT_SLOW
    call PAYLOAD_ESCAPE
    jr c,PAYLOAD_WAIT_DONE
    jr PAYLOAD_WAIT_SLOW
PAYLOAD_WAIT_DONE:
    pop bc
    ret
; Tail of PAYLOAD_ESCAPE, placed before it so the DOS ROM keeps it in the wait
; hole: the ESC hole is too small for the two-row check. C bit 2 = 0 when
; CTRL+ESC is down, B = port AA to restore, incoming IFF state on the stack.
PAYLOAD_ESCAPE_DONE:
    ld a,b
    out (0xaa),a
    pop af
    jp po,PAYLOAD_ESCAPE_IFF_OFF
    ei
PAYLOAD_ESCAPE_IFF_OFF:
    ld a,c
    pop bc
    and 4
    ret nz
    ld a,0xe2
    scf
    ret
; Abort key is CTRL+ESC: ESC alone stays an ordinary key for programs.
; ESC = row 7 bit 2, CTRL = row 6 bit 1, both active low.
; Preserve row selection, upper PPI bits and the incoming interrupt state.
; No BIOS call: safe with interrupts disabled, no reliance on BSS.
